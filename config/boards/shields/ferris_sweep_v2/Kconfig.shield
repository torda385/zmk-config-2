## config/boards/shields/ferris_sweep_v2/Kconfig.shield
```kconfig
# Copyright (c) 2020 Pete Johanson
# SPDX-License-Identifier: MIT

config SHIELD_FERRIS_SWEEP_V2_LEFT
	def_bool $(shields_list_contains,ferris_sweep_v2_left)

config SHIELD_FERRIS_SWEEP_V2_RIGHT
	def_bool $(shields_list_contains,ferris_sweep_v2_right)
```

## config/west.yml
```yaml
manifest:
  remotes:
    - name: zmkfirmware
      url-base: https://github.com/zmkfirmware
    - name: muppetjones
      url-base: https://github.com/muppetjones
  projects:
    - name: zmk
      remote: zmkfirmware
      revision: main
      import: app/west.yml
  self:
    path: config
```
